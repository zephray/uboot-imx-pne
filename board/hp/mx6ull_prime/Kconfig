## board/hp/mx6ull_prime/Kconfig
```kconfig
if TARGET_MX6ULL_PRIME

config SYS_BOARD
       default "mx6ull_prime"

config SYS_VENDOR
       default "hp"

config SYS_CONFIG_NAME
       default "mx6ull_prime"

config SYS_TEXT_BASE
	default 0x87800000

endif
```

## board/zephray/rhythmpocket/Kconfig
```kconfig
if TARGET_RHYTHMPOCKET

config SYS_BOARD
	default "rhythmpocket"

config SYS_VENDOR
	default "zephray"

config SYS_CONFIG_NAME
	default "rhythmpocket"

endif
```

## configs/mx6ull_prime_defconfig
```kconfig
CONFIG_SYS_EXTRA_OPTIONS="IMX_CONFIG=board/hp/mx6ull_prime/imximage.cfg"
CONFIG_ARM=y
CONFIG_ARCH_MX6=y
CONFIG_TARGET_MX6ULL_PRIME=y
CONFIG_VIDEO=y
CONFIG_DEFAULT_DEVICE_TREE="imx6ull-prime"
CONFIG_DEFAULT_FDT_FILE="imx6ull-prime.dtb"
CONFIG_BOOTDELAY=3
# CONFIG_CONSOLE_MUX is not set
CONFIG_SYS_CONSOLE_IS_IN_ENV=y
CONFIG_BOARD_EARLY_INIT_F=y
CONFIG_HUSH_PARSER=y
CONFIG_CMD_BOOTZ=y
# CONFIG_CMD_IMLS is not set
CONFIG_CMD_MEMTEST=y
CONFIG_CMD_USB=y
CONFIG_CMD_I2C=y
CONFIG_CMD_GPIO=y
CONFIG_CMD_BMP=y
CONFIG_CMD_CACHE=y
CONFIG_CMD_EXT2=y
CONFIG_CMD_EXT4=y
CONFIG_CMD_EXT4_WRITE=y
CONFIG_CMD_FAT=y
CONFIG_CMD_FS_GENERIC=y
CONFIG_OF_CONTROL=y
CONFIG_DM_GPIO=y
CONFIG_DM_I2C=y
CONFIG_PINCTRL=y
CONFIG_PINCTRL_IMX6=y
CONFIG_USB=y
CONFIG_DM_USB=y
CONFIG_USB_HOST_ETHER=y
CONFIG_USB_ETHER_ASIX=y
CONFIG_USB_STORAGE=y
CONFIG_DM_ETH=y
```
